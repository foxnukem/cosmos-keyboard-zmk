## boards/shields/cosmos_keyboard/Kconfig.shield
```kconfig
config SHIELD_COSMOS_KEYBOARD_LEFT
    def_bool $(shields_list_contains,cosmos_keyboard_left)

config SHIELD_COSMOS_KEYBOARD_RIGHT
    def_bool $(shields_list_contains,cosmos_keyboard_right)
```
